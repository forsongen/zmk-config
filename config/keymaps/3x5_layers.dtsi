//                                RAISE
//  ╭─────────────────────────╮           ╭─────────────────────────╮
//  │ app  home  ↻   end  tab │           │ pg↑   Z    ×    Q  BTCLR│
//  │ ←wd   ←    ↑    →   →wd │           │ pg↓  BT3  BT4   ×    ×  │
//  │  ×    ×    ↓   bspc del ╰────╮ ╭────╯  ×   BT0  BT1  BT2   ×  │
//  ╰────────────╮  reset  ●  boot │ │  × overlay ×    ╭────────────╯
//               ╰─────────────────╯ ╰─────────────────╯

                ZMK_LAYER(RAISE,
&app_swap     &kp HOME   &kp RG(R)  &kp END    &tab_swap        &kp PG_UP  &kp Z      &none      &kp Q      &bt BT_CLR
&kp LA(LEFT)  &kp LEFT   &kp UP     &kp RIGHT  &kp LA(RIGHT)    &kp PG_DN  &bt BT(3)  &bt BT(4)  &none      &none
&none         &none      &kp DOWN   &kp BSPC   &kp DEL          &none      &bt BT(0)  &bt BT(1)  &bt BT(2)  &none
//
                              &sys_reset  &none  &bootloader    &none  &kp F21  &none
                )

//                                LOWER
//  ╭─────────────────────────╮           ╭─────────────────────────╮
//  │  F1   F2   F3   F4   ×  │           │  ×    Z    ×    Q    ×  │
//  │  F5   F6   F7   F8   ×  │           │  ×   mute vol↑ p/p   ×  │
//  │  F9  F10  F11  F12   ×  ╰────╮ ╭────╯ lclk rclk vol↓  ×    ×  │
//  ╰────────────╮    × overlay ×  │ │ boot  ●  reset  ╭────────────╯
//               ╰─────────────────╯ ╰─────────────────╯

                ZMK_LAYER(LOWER,
&kp F1  &kp F2   &kp F3   &kp F4   &none    &none      &kp Z       &none         &kp Q     &none
&kp F5  &kp F6   &kp F7   &kp F8   &none    &none      &kp C_MUTE  &kp C_VOL_UP  &kp C_PP  &none
&kp F9  &kp F10  &kp F11  &kp F12  &none    &mkp LCLK  &mkp RCLK   &kp C_VOL_DN  &none     &none
//
                   &none  &kp F22  &none    &bootloader  &none  &sys_reset
                )

//                                SYMBOL
//  ╭─────────────────────────╮           ╭─────────────────────────╮
//  │  `    \    /    @    *  │           │  #    .    (    )    ;  │
//  │  <    =    -    >    +  │           │  ,    {    '    "    }  │
//  │  !    &    |    %    _  ╰────╮ ╭────╯  ^    $    [    ]    ~  │
//  ╰────────────╮   ENT   R    sk │ │ sk   SPC  BSPC  ╭────────────╯
//               ╰─HYPER─RAISE─SHFT╯ ╰SHFT─LOWER─HYPER─╯

                ZMK_LAYER(SYM,
&lkgrv M GRAVE  &kp BSLH   &kp FSLH   &kp AT     &kp STAR     &HASHDLLR   &DOTCOLON      &lkpar M LPAR  &kp RPAR  &kp SEMI
&lkltgt M LT    &kp EQUAL  &kp MINUS  &kp GT     &kp PLUS     &COMMASEMI  &lkbrc M LBRC  &kp SQT        &kp DQT   &kp RBRC
&kp EXCL        &kp AMPS   &kp PIPE   &kp PRCNT  &kp UNDER    &kp CARET   &kp DLLR       &lkbkt M LBKT  &kp RBKT  &kp TILDE
//
                                    &trans  &trans  &trans    &trans  &trans  &trans
                )

//                               NUMBER
//  ╭─────────────────────────╮           ╭─────────────────────────╮
//  │  .    7    8    9    ,  │           │  ,    7    8    9    .  │
//  │  +    4    5    6    -  │           │  -    4    5    6    +  │
//  │  *    1    2    3    /  ╰────╮ ╭────╯  /    1    2    3    *  │
//  ╰────────────╮   ENT  SPC   0  │ │  0   SPC  BSPC  ╭────────────╯
//               ╰─HYPER─RAISE─SHFT╯ ╰SHFT─LOWER─HYPER─╯

                ZMK_LAYER(NUM,
&kp DOT   &kp N7  &kp N8  &kp N9  &kp COMMA    &kp COMMA  &kp N7  &kp N8  &kp N9  &kp DOT
&kp PLUS  &kp N4  &kp N5  &kp N6  &kp MINUS    &kp COLON  &kp N4  &kp N5  &kp N6  &kp PLUS
&kp STAR  &kp N1  &kp N2  &kp N3  &kp FSLH     &kp FSLH   &kp N1  &kp N2  &kp N3  &kp STAR
//
       &trans  &lt RAISE SPC   &mt LSHFT N0    &mt RSHFT N0  &trans  &trans
                )