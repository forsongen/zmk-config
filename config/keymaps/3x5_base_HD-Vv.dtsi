//                                BASE
//                        Hands Down Vibranium v
//  ╭─────────────────────────╮           ╭─────────────────────────╮
//  │  X    W    M    G    J  │           │  #$   .:   '(   ")   B  │
//  │  S    C    N    T    K  │           │  ,;   A    E    I    H  │
//  │  V    P    L    D    /* ╰────╮ ╭────╯  -+   U    O    Y    F  │
//  ╰────────────╮   ENT   R    sk │ │ sk   SPC  BSPC  ╭────────────╯
//               ╰─HYPER─RAISE─SHFT╯ ╰SHFT─LOWER─HYPER─╯

                ZMK_LAYER(BASE,

&kp X  &kp W  &kp M  &kp G  &kp J        &HASHDLLR   &DOTCOLON  &SQTLPAR  &DQTRPAR  &kp B
&kp S  &kp C  &kp N  &kp T  &kp K        &COMMASEMI  &kp A      &kp E     &kp I     &kp H
&kp V  &kp P  &kp L  &kp D  &FSLHSTAR    &MINUSPLUS  &kp U      &kp O     &kp Y     &kp F
//
    &mt HYPER ENTER  &lt RAISE R  &superLSHFT    &superRSHFT  &L_SPCTAB   &H_BSPCDEL
                )