#include <behaviors.dtsi>
#include <dt-bindings/zmk/keys.h>
#include <dt-bindings/zmk/bt.h>
#include <dt-bindings/zmk/mouse.h>

#include "./keymaps/3x5_keypos.h"
#include "config.h"

/ {
    #include "./behaviors/macros.dtsi"
    #include "./behaviors/behaviors.dtsi"
    #include "./behaviors/combos.dtsi"
    #if defined ENABLE_PRONOUNS
        #include "./behaviors/pronouns.dtsi"
    #endif // ENABLE_PRONOUNS


    keymap {
        compatible = "zmk,keymap";
        #include "./keymaps/3x5_base_HD-Vv.dtsi"  // base layer
        #include "./keymaps/3x5_layers.dtsi"      // all other layers
    };
};